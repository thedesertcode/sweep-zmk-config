// Copyright (c) 2022 The ZMK Contributors
// SPDX-License-Identifier: MIT

#include "cradio.dtsi"

&kscan0 {
    debounce-press-ms = <1>;
    debounce-release-ms = <1>;
    debounce-scan-period-ms = <1>;
};
