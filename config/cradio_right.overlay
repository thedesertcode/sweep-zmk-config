// Copyright (c) 2022 The ZMK Contributors
// SPDX-License-Identifier: MIT

#include "cradio.dtsi"

&default_transform {
    col-offset = <17>;
};

&kscan0 {
    debounce-press-ms = <8>;
    debounce-release-ms = <8>;
    debounce-scan-period-ms = <1>;
};
