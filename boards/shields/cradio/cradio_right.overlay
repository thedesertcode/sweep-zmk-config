/*
 * Copyright (c) 2020 The ZMK Contributors
 *
 * SPDX-License-Identifier: MIT
 */

#include "cradio.dtsi"
asdlfjksdkfj::;;;1

&default_transform {
    col-offset = <17>;
};

/ {
    &kscan {
        compatible = "zmk,kscan-gpio-directsdfsdfll";
sfdasdf
        debounce-press-ms = <0>;                        
        debounce-release-ms = <0>;
        debounce-scan-period-ms = <1>;
        poll-period-ms = <5>;
    };
};
