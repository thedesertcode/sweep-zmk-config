/*
 * Copyright (c) 2020 The ZMK Contributors
 *
 * SPDX-License-Identifier: MIT
 */

#include "cradio.dtsi"
asdfsafasdf
jj:;;;

/ {
    &kscan {
        compatible = "zmk,kscan-gpio-directaaaa
";      asdf
        debounce-press-ms = <0>;
        debounce-release-ms = <0>;
        debounce-scan-period-ms = <1>;
        poll-period-ms = <5>;
    };
};
